## package/libblepp/Config.in
```kconfig
config BR2_PACKAGE_LIBBLEPP
  bool "libblepp"
  
  select BR2_PACKAGE_BLUEZ5_TOOLS
  select BR2_PACKAGE_BLUEZ5_UTILS
  select BR2_PACKAGE_BLUEZ5_UTILS_COMPAT
  select BR2_PACKAGE_BLUEZ5_UTILS_USB
  select BR2_PACKAGE_BLUEZ5_UTILS_GATT


  select BR2_PACKAGE_BOOST
  select BR2_PACKAGE_BOOST_CONTAINER
  select BR2_PACKAGE_BOOST_CONTRACT
  select BR2_PACKAGE_BOOST_COROUTINE
  select BR2_PACKAGE_BOOST_EXCEPTION
  select BR2_PACKAGE_BOOST_FIBER
  select BR2_PACKAGE_BOOST_GRAPH
  select BR2_PACKAGE_BOOST_GRAPH_PARALLEL
  select BR2_PACKAGE_BOOST_IOSTREAMS
  select BR2_PACKAGE_BOOST_LOCALE
  select BR2_PACKAGE_BOOST_LOG
  select BR2_PACKAGE_BOOST_MATH
  select BR2_PACKAGE_BOOST_MPI
  select BR2_PACKAGE_BOOST_PROGRAM_OPTIONS
  select BR2_PACKAGE_BOOST_RANDOM
  select BR2_PACKAGE_BOOST_SERIALIZATION
  select BR2_PACKAGE_BOOST_SIGNALS
  select BR2_PACKAGE_BOOST_STACKTRACE
  select BR2_PACKAGE_BOOST_TIMER
  select BR2_PACKAGE_BOOST_TYPE_ERASURE
  select BR2_PACKAGE_BOOST_WAVE

  help
    Implementation of Bluetooth Low Energy functions in modern C++, 
    without the BlueZ DBUS API.
```
